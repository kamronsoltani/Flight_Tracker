#include <Wire.h>
#include <WiFi.h>
#include <WiFiClientSecure.h>
#include <HTTPClient.h>
#include <ArduinoJson.h>
#include <ESP32-HUB75-MatrixPanel-I2S-DMA.h>
#include <Fonts/Org_01.h>
#include "freertos/FreeRTOS.h"
#include "freertos/task.h"
#include "secrets.h"

// ========== PANEL CONFIG ==========
#define PANEL_RES_X 64
#define PANEL_RES_Y 32
#define PANEL_CHAIN 1

#define R1_PIN 25
#define G1_PIN 26
#define B1_PIN 33
#define R2_PIN 14
#define G2_PIN 27
#define B2_PIN 12

#define A_PIN 4
#define B_PIN 5
#define C_PIN 19
#define D_PIN 21
#define E_PIN 32

#define LAT_PIN 13
#define OE_PIN 7
#define CLK_PIN 15

MatrixPanel_I2S_DMA* dma_display = nullptr;

#include "cloud_control.h"

// ========== CONFIGURATION ==========
// Berkeley-IoT: password is per-device (MAC) at https://wifi-keys.berkeley.edu
// After you reset the key there, update password below to match.
const char* ssid = WIFI_SSID;
const char* password = WIFI_PASSWORD;
const float MY_LAT = 37.6435018;
const float MY_LON = -122.365018;

const int MIN_ALTITUDE = 1000;
// Larger radius finds more airborne commercials near SFO; API responses
// are stream-filtered so size is OK for ESP32 heap.
const int SEARCH_RADIUS = 15;
const int ADSB_API_RADIUS_CAP = 25;

#define METRIC_HOLD_MS 4000
#define NUM_METRICS 3

// ========== COLORS ==========
#define COL_BLACK 0x0000
#define COL_WHITE 0xFFFF
uint16_t COL_ORANGE;
uint16_t COL_YELLOW;

// ========== COMMERCIAL FILTER ==========
const char* COMMERCIAL_PREFIXES[] = {
  "UAL",
  "DAL",
  "AAL",
  "SWA",
  "ASA",
  "JBU",
  "NKS",
  "HAL",
  "VRD",
  "FFT",
  "SKW",
  "RPA",
  "OPT",
  "AWI",
  "ENY",
  "PDT",
  "CPZ",
  "FLG",
  "SCI",
  "QXE",
  "ASH",
  "BTA",
  "TCF",
  "KAP",
  "GJS",
  "EDV",
  "AGS",
  "CHQ",
  "LOF",
  "FDX",
  "UPS",
  "DHL",
  "ABX",
  "GTI",
  "ATN",
  "CLX",
  "PAC",
  "NCB",
  "CSQ",
  "ANZ",
  "QFA",
  "SIA",
  "CPA",
  "ANA",
  "JAL",
  "KAL",
  "AAR",
  "CSN",
  "CCA",
  "AFR",
  "BAW",
  "KLM",
  "DLH",
  "AZA",
  "IBE",
  "TAM",
  "AVA",
  "LAN",
  "EIN",
  "AER",
  "THY",
  "MEA",
  "ETD",
  "SVA",
  "QTR",
  "MAS",
  "THA",
  "VIR",
  "EWG",
  "AIC",
  "UAE",
  "ETH",
  "KQA",
  "MSR",
  "RAM",
  "TAP",
  "IBS",
  "VLG",
  "BEL",
  "SAS",
  "FIN",
  "NOZ",
  "WZZ",
  "RYR",
  "EZY",
  "TOM",
  "TCX",
  "MTI",
  "AA",
  "UA",
  "DL",
  "WN",
  "AS",
  "B6",
  "NK",
  "HA",
  "VX",
  "F9",
  "LH",
  "BA",
  "AF",
  "KL",
  "IB",
  "TK",
  "EK",
  "QR",
  "SQ",
  "CX",
  "NH",
  "JL",
  "KE",
  "OZ",
  "CA",
  "MU",
  "CZ",
  "AI",
  "TG",
  "MH",
  "EY",
  "MS",
  "ET",
  "RJ",
  "ME",
  "SV",
  "QF",
  "NZ",
  "VS",
  "EI",
  "FX",
  "5X",
  "QX",
  "YV",
};
const int NUM_COMMERCIAL = sizeof(COMMERCIAL_PREFIXES) / sizeof(COMMERCIAL_PREFIXES[0]);

const char* BLOCKED_TYPES[] = {
  "C25A",
  "C25B",
  "C25C",
  "C510",
  "C525",
  "C550",
  "C560",
  "C56X",
  "C680",
  "C700",
  "C750",
  "CL30",
  "CL35",
  "CL60",
  "GL5T",
  "GL7T",
  "GLEX",
  "G150",
  "G200",
  "G280",
  "G350",
  "G450",
  "G500",
  "G550",
  "G600",
  "G650",
  "H25A",
  "H25B",
  "H25C",
  "FA10",
  "FA20",
  "FA50",
  "FA7X",
  "FA8X",
  "E35L",
  "E45X",
  "E55P",
  "PC12",
  "TBM7",
  "TBM8",
  "TBM9",
  "BE20",
  "BE40",
  "BE9L",
  "LJ35",
  "LJ40",
  "LJ45",
  "LJ55",
  "LJ60",
  "LJ75",
  "MU2",
  "PRM1",
  "SBR1",
  "SBR2",
  "PC24",
  "SF50",
  "EC35",
  "EC45",
  "H500",
  "R44",
  "R66",
  "AS32",
  "S76",
  "S92",
  "A139",
  "AW13",
  "AW16",
  "B06",
  "B06T",
  "H60",
  "UH60",
  "EC20",
  "C172",
  "C182",
  "C208",
  "PA28",
  "PA32",
  "PA44",
  "SR20",
  "SR22",
  "DA40",
  "DA42",
  "BE36",
  "BE58",
  "C402",
  "C414",
  "C421",
  "P28A",
  "P28B",
  "P28R",
  "P32R",
  "C152",
  "C162",
  "C177",
  "C205",
  "C206",
};
const int NUM_BLOCKED = sizeof(BLOCKED_TYPES) / sizeof(BLOCKED_TYPES[0]);

bool isCommercialCallsign(const char* callsign) {
  for (int i = 0; i < NUM_COMMERCIAL; i++) {
    int len = strlen(COMMERCIAL_PREFIXES[i]);
    if (strncmp(callsign, COMMERCIAL_PREFIXES[i], len) == 0 && isdigit(callsign[len])) {
      return true;
    }
  }
  return false;
}

bool isBlockedType(const char* acType) {
  for (int i = 0; i < NUM_BLOCKED; i++) {
    if (strcmp(acType, BLOCKED_TYPES[i]) == 0) return true;
  }
  return false;
}

// ========== UNITED (20x20) ==========
static const uint16_t PROGMEM logo_united[] = {
  0x10BA, 0x10BA, 0x10BA, 0x10BA, 0x10BA, 0x10BA, 0x10BA, 0x10BA, 0x10BA, 0x10BA, 0x10BA, 0x10BA, 0x10BA, 0x10BA, 0x10BA, 0x10BA, 0x10BA, 0x10BA, 0x10BA, 0x10BA,
  0x10BA, 0x10BA, 0x10BA, 0x10BA, 0x10BA, 0x10BA, 0x10BA, 0x10BA, 0x10BA, 0x10BA, 0x10BA, 0x10BA, 0x10BA, 0x10BA, 0x10BA, 0x10BA, 0x10BA, 0x10BA, 0x10BA, 0x10BA,
  0x10BA, 0x10BA, 0x10BA, 0x10BA, 0x10BA, 0x10BA, 0x10BA, 0x10BA, 0x10BA, 0x10BA, 0x10BA, 0x10BA, 0x10BA, 0x10BA, 0x10BA, 0x10BA, 0x10BA, 0x10BA, 0x10BA, 0x10BA,
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  0x10BA, 0x10BA, 0xFFFF, 0x10BA, 0xFFFF, 0x10BA, 0xFFFF, 0xFFFF, 0x10BA, 0x10BA, 0x10BA, 0xFFFF, 0x10BA, 0x10BA, 0x10BA, 0x10BA, 0x10BA, 0xFFFF, 0xFFFF, 0x10BA
};

// ========== DELTA (20x16) ==========
static const uint16_t PROGMEM logo_delta[] = {
  0xFFFF, 0xFFFF, 0xFFFF, 0xFFFF, 0xFFFF, 0xFFFF, 0xFFFF, 0xFFFF, 0xFFFF, 0xFFFF, 0xE4F6, 0xFFFF, 0xFFFF, 0xFFFF, 0xFFFF, 0xFFFF, 0xFFFF, 0xFFFF, 0xFFFF, 0xFFFF,
  0xFFFF, 0xFFFF, 0xFFFF, 0xFFFF, 0xFFFF, 0xFFFF, 0xFFFF, 0xFFFF, 0xFFFF, 0xE8C6, 0x9805, 0xFFFF, 0xFFFF, 0xFFFF, 0xFFFF, 0xFFFF, 0xFFFF, 0xFFFF, 0xFFFF, 0xFFFF,
  0xFFFF, 0xFFFF, 0xFFFF, 0xFFFF, 0xFFFF, 0xFFFF, 0xFFFF, 0xFFFF, 0xFEDC, 0xE0C6, 0x9806, 0x9805, 0xFFFF, 0xFFFF, 0xFFFF, 0xFFFF, 0xFFFF, 0xFFFF, 0xFFFF, 0xFFFF,
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  0xFFFF, 0xE0A7, 0xE0C6, 0xE0C6, 0xE0C6, 0xE0C6, 0xE0C6, 0xE0C6, 0xE0C6, 0xE0C6, 0x9005, 0x9005, 0x9005, 0x9005, 0x9005, 0x9005, 0x9005, 0x9005, 0x9005, 0xFF7E
};

// ========== AMERICAN (20x20) ==========
static const uint16_t PROGMEM logo_american[] = {0x0000,0x0000,0x0000,0x0000,0x0000,0x0000,0x0000,0x0000,0x0000,0x0000,0x0000,0x0000,0x0000,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0x0000,0x0000};


// ========== SOUTHWEST (19x18) ==========
static const uint16_t PROGMEM logo_southwest[] = { 0x0000, 0x0000, 0xF7BF, 0xF7BF, 0xF8A3, 0xF8A3, 0xF8A3, 0xF7BF, 0xF7BF, 0x0000, 0xF79E, 0xF79E, 0xFDA0,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 0x0000, 0x0000 };

// ========== ALASKA (19x18) ==========
static const uint16_t PROGMEM logo_alaska[] = { 0x0000, 0x0000, 0x0000, 0x0000, 0x0000, 0x0000, 0x4558, 0x4558, 0x4558, 0x4558, 0x124E, 0x4558, 0xB6CF,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 0x0000, 0x0000 };

// ========== LUFTHANSA (20x20) ==========
static const uint16_t PROGMEM logo_lufthansa[] = { 0xFFFF, 0xFFFF, 0xFFFF, 0xFFFF, 0xFFFF, 0xFFFF, 0x10EA, 0x10CA, 0xE583, 0xFD60, 0xFDA0, 0xDD46, 0x10CA,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 0xFFFF, 0xFFFF };

// ========== Jetblue (20x20) ==========
static const uint16_t PROGMEM logo_jetblue[] = {0x043A,0x043A,0x043A,0x043A,0x045A,0x05BC,0x05BC,0x05BC,0x05BC,0x041A,0x043A,0x043A,0x043A,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0x0194,0x0194};

// ========== Air Canada (19x19) ==========
static const uint16_t PROGMEM logo_aircanada[] = { 0x0000, 0x0000, 0x0000, 0x0000, 0x0000, 0x0000, 0xF0A5, 0xF0A5, 0xF0A5, 0xF0A5, 0xF0A5, 0xF0A5, 0xF0A5,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 0x0000, 0x0000 };

// ========== Hawaiian (20x23) ==========
static const uint16_t PROGMEM logo_hawaiian[] = { 0x0000, 0x0000, 0x0000, 0x0000, 0x0000, 0x0000, 0x0000, 0xF011, 0xF011, 0xF011, 0xF011, 0xF011, 0xF011,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 0x0000, 0x0000 };

// ========== emirates (16x19) ==========
static const uint16_t PROGMEM logo_emirates[] = { 0xFFFF, 0xFFFF, 0xFFFF, 0xFFFF, 0xFFFF, 0xFFFF, 0xFFFF, 0xFFFF, 0xFFFF, 0xFFFF, 0xFFFF, 0xFFFF, 0xFFFF,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 0xFFFF, 0xFFFF };

// ========== korean (16x19) ==========
static const uint16_t PROGMEM logo_korean[] = { 0x0000, 0x0000, 0x0000, 0x0000, 0x0000, 0x0000, 0x0000, 0x0000, 0x0000, 0x0000, 0x0000, 0x0000, 0x0000,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 0x0000, 0x0000 };

// ========== JAL (20x20) ==========
static const uint16_t PROGMEM logo_jal[] = {0x0000,0x0000,0x0000,0x0000,0x0000,0x0000,0x0000,0x0000,0x0000,0x0000,0xE002,0x0000,0x0000,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0x0000,0x0000};

// ========== ANA (19x14) ==========
static const uint16_t PROGMEM logo_ana[] = {0xFFFF,0xFFFF,0xFFFF,0xFFFF,0xFFFF,0xFFFF,0xFFFF,0xFFFF,0x0991,0x0991,0x0991,0x0991,0x0991,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0xFFFF,0xFFFF};

// ========== Cathay (20x20) ==========
static const uint16_t PROGMEM logo_cathay[] = {0x02EC,0x02EC,0x02EC,0x02EC,0x02EC,0x02EC,0x02EC,0x02EC,0x02EC,0x02EC,0x02EC,0x02EC,0x02EC,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0x02EC,0x02EC};

// ========== KLM (20x20) ==========
static const uint16_t PROGMEM logo_klm[] = {0x04B9,0x04B9,0x04B9,0x04B9,0x04B9,0x04B9,0x04B9,0x04B9,0x04B9,0x04B9,0x04B9,0x04B9,0x04B9,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0x04B9,0x04B9};

// ========== AirFrance (20x14) ==========
static const uint16_t PROGMEM logo_france[] = {0xFFFF,0xFFFF,0xFFFF,0xFFFF,0xFFFF,0xFFFF,0xFFFF,0xFFFF,0xFFFF,0xFFFF,0xFFFF,0xF842,0xF863,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0xFFFF,0xFFFF};

// ========== BritishAirways (17x5) ==========
static const uint16_t PROGMEM logo_british[] = {0xEA21,0xF9E0,0xF9E0,0xF9E0,0xF9E0,0xF9E0,0xF9E0,0xF9E0,0xF9E0,0xF9E0,0xF9E0,0xF9E0,0xF9E0,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0xFFFF,0xFFFF};

// ========== qatar (20x20) ==========
static const uint16_t PROGMEM logo_qatar[] = {0xFFFF,0xFFFF,0xFFFF,0xFFFF,0xFFFF,0xFFFF,0xFFFF,0xFFFF,0xFFFF,0xFFFF,0xFFFF,0xFFFF,0xFFFF,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0xFFFF,0xFFFF};

// ========== singapore (14x19) ==========
static const uint16_t PROGMEM logo_sg[] = {0x0000,0x0000,0x0000,0x0000,0x0000,0x0000,0x0000,0x0000,0x0000,0x0000,0x0000,0x0000,0x0000,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0x0000,0x0000};

// ========== asiana (20x20) ==========
static const uint16_t PROGMEM logo_asiana[] = {0xFFFF,0xFFFF,0xFFFF,0xFFFF,0xFFFF,0xFFFF,0xFFFF,0xFFFF,0xFFFF,0xFFFF,0xFFFF,0xFFFF,0xFFFF,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0xFFFF,0xFFFF};

// ========== virgin (20x20) ==========
static const uint16_t PROGMEM logo_virgin[] = {0x0000,0x0000,0x0000,0x0000,0x0000,0x0000,0x0000,0x0000,0x0000,0x0000,0xC905,0x0000,0x0000,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0x0000,0x0000};

// ========== spirit (20x20) ==========
static const uint16_t PROGMEM logo_spirit[] = {0xFF60,0xFF60,0xFF60,0xFF60,0xFF60,0xFF60,0xFF60,0xFF60,0xFF60,0xFF60,0xFF60,0xFF60,0xFF60,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0xFF60,0xFF60};

// ========== allegiant (20x10) ==========
static const uint16_t PROGMEM logo_allegiant[] = {0xFFFF,0xFFFF,0xFFFF,0xFFFF,0xFFFF,0xFFFF,0xFFFF,0xFFFF,0xFFFF,0xFFFF,0xF4CB,0xFFFF,0xFFFF,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0xFFFF,0xFFFF};

// ========== tahiti (20x20) ==========
static const uint16_t PROGMEM logo_tahiti[] = {0x01AC,0x01AC,0x01AC,0x01AC,0x01AC,0x01AC,0x01AC,0x01AC,0x01AC,0x01AC,0x01AC,0x01AC,0x01AC,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0x01AC,0x01AC};

// ========== frontier (20x20) ==========
static const uint16_t PROGMEM logo_frontier[] = {0x0225,0x0225,0x0225,0x0225,0x0225,0x0225,0x0225,0x0225,0x0225,0x0225,0x0225,0x0225,0x0225,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0x0225,0x0225};

// ========== Fedex (20x21) ==========
static const uint16_t PROGMEM logo_fedex[] = {0xFFFF,0xFFFF,0xFFFF,0xFFFF,0xFFFF,0xFFFF,0xFFFF,0xFFFF,0xFFFF,0xFFDF,0x97BF,0xFFFF,0xFFFF,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0xFFFF,0xFFFF};

// ========== UPS (17x20) ==========
static const uint16_t PROGMEM logo_ups[] = {0x0000,0x0000,0x0000,0x0000,0x0000,0x0000,0x0000,0x0000,0x0000,0x0000,0x0000,0x0000,0x0000,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0x0000,0x0000};

// ========== EVA (20x15) ==========
static const uint16_t PROGMEM logo_eva[] = {0x0000,0x0000,0x0000,0x0000,0x0000,0x0000,0x0000,0x0000,0x0000,0x0000,0x0000,0x0000,0x0529,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0x0000,0x0000};

// ========== China airlines (20x16) ==========
static const uint16_t PROGMEM logo_china[] = {0x0000,0x0000,0x0000,0x0000,0x0000,0x0000,0x0000,0x0000,0x0000,0x0000,0x0000,0x0000,0x0000,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0x0000,0x0000};

// ========== air new zealand (20x20) ==========
static const uint16_t PROGMEM logo_anz[] = {0xFFFF,0xFFFF,0xFFFF,0xFFFF,0xFFFF,0xFFFF,0xFFFF,0xFFFF,0xFFFF,0xFFFF,0xFFFF,0xFFFF,0x41E8,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0xFFFF,0xFFFF};

// ========== starlux (20x20) ==========
static const uint16_t PROGMEM logo_starlux[] = {0xFFFF,0xFFFF,0xFFFF,0xFFFF,0xFFFF,0xFFFF,0xFFFF,0xFFFF,0xFFFF,0xFFFF,0xFFFF,0xFFFF,0xFFFF,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0xFFFF,0xFFFF};

// ========== zipair (20x16) ==========
static const uint16_t PROGMEM logo_zipair[] = {0xFFFF,0x8C51,0x0000,0x0000,0x0000,0x0000,0x0000,0x0000,0x0000,0x0000,0x0000,0x0000,0x6B4D,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0x1CAF,0x1CAF};

// ========== aeromexico (20x18) ==========
static const uint16_t PROGMEM logo_mexico[] = {0xFFFF,0xFFFF,0xFFFF,0xFFFF,0xFFFF,0xFFFF,0xFFFF,0xFFFF,0xFFFF,0xFFFF,0xFFFF,0xFFFF,0xFFFF,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0xFFFF,0xFFFF};

// ========== condor (20x20) ==========
static const uint16_t PROGMEM logo_condor[] = {0x0000,0x0000,0x0000,0x0000,0x0000,0x0000,0x0000,0x0000,0x0000,0x0000,0x0000,0x0000,0x0000,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0x0000,0x0000};

// ========== avianca (20x20) ==========
static const uint16_t PROGMEM logo_avianca[] = {0xFFFF,0xFFFF,0xFFFF,0xFFFF,0xFFFF,0xFFFF,0xFFFF,0xFFFF,0xFFFF,0xFFFF,0xFFFF,0xFFFF,0xFFFF,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0xFFFF,0xFFFF};

// ========== lot (19x19) ==========
static const uint16_t PROGMEM logo_lot[] = {0xFFFF,0xFFFF,0xFFFF,0xFFFF,0xFFFF,0x1081,0x39E7,0xFFFF,0xFFFF,0xFFFF,0x18A2,0xFFFF,0x3165,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0xFFFF,0xFFFF};

// ========== air_india (19x19) ==========
static const uint16_t PROGMEM logo_airindia[] = {0xFFFF,0xFFFF,0xFFFF,0xFFFF,0xFFFF,0xFFFF,0xFFFF,0xFFFF,0xFFFF,0xFFFF,0xFFFF,0xFFFF,0xFFFF,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0xFFFF,0xFFFF};

// ========== vietnam (20x20) ==========
static const uint16_t PROGMEM logo_vietnam[] = {0x0350,0x0350,0x0350,0x0350,0x0350,0x0350,0x0350,0x0350,0x0350,0x0350,0x0350,0x0350,0x0350,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0x0350,0x0350};

// ========== philippine (20x20) ==========
static const uint16_t PROGMEM logo_philippine[] = {0xFFFF,0xFFFF,0xFFFF,0xFFFF,0xFFFF,0xFFFF,0xFFFF,0xFFFF,0xFFFF,0xFFFF,0xFFFF,0xFFFF,0xFFFF,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0xFFFF,0xFFFF};

// ========== turkish (20x20) ==========
static const uint16_t PROGMEM logo_turkish[] = {0x0000,0x0000,0x0000,0x0000,0x0000,0x0000,0x0000,0x0000,0x0000,0x0000,0x0000,0x0000,0x0000,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0x0000,0x0000};

// ========== qantas (19x19) ==========
static const uint16_t PROGMEM logo_qantas[] = {0xFFFF,0xFFFF,0xFFFF,0xFFFF,0xFFFF,0xFFFF,0xFFFF,0xFFFF,0xFFFF,0xFFFF,0xFFFF,0xFFFF,0xFFFF,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0xFFFF,0xFFFF};

// ========== fiji (20x20) ==========
static const uint16_t PROGMEM logo_fiji[] = {0x3944,0x3944,0x3944,0x3944,0x3944,0x3944,0x3944,0x3944,0x3944,0x3944,0x3944,0x3944,0x3944,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0x3944,0x3944};

// ========== copa (20x20) ==========
static const uint16_t PROGMEM logo_copa[] = {0x02F5,0x02F5,0x02F5,0x02F5,0x02F5,0x02F5,0x02F5,0x02F5,0x02F5,0x02F5,0x02F5,0x02F5,0x02F5,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0x02F5,0x02F5};

// ========== swiss (20x20) ==========
static const uint16_t PROGMEM logo_swiss[] = {0xFFFF,0xFFFF,0xFFFF,0xFFFF,0xFFFF,0xFFFF,0xFFFF,0xFFFF,0xFFFF,0xFF9E,0xD128,0xD128,0xD128,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0xFFFF,0xFFFF};

// ========== sas (20x20) ==========
static const uint16_t PROGMEM logo_sas[] = {0x0013,0x0013,0x0013,0x0013,0x0013,0x0013,0x0013,0x0013,0x0013,0x0013,0x0013,0x0013,0x0013,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0x0013,0x0013};

// ========== tap_portugal (20x20) ==========
static const uint16_t PROGMEM logo_tap[] = {0xFFFF,0xFFFF,0xFFFF,0xFFFF,0xFFFF,0xFFFF,0xFFFF,0xFFFF,0xFFFF,0xFFFF,0xFFFF,0xFFFF,0xFFFF,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0xFFFF,0xFFFF};

// ========== ita_airways (20x20) ==========
static const uint16_t PROGMEM logo_ita[] = {0xFFFF,0xFFFF,0xFFFF,0xFFFF,0xFFFF,0xFFFF,0xFFFF,0xFFFF,0xFFFF,0xFFFF,0xFFFF,0xFFFF,0xFFFF,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0xFFFF,0xFFFF};

// ========== aer_lingus (20x20) ==========
static const uint16_t PROGMEM logo_aerlingus[] = {0xFFFF,0xFFFF,0xFFFF,0xFFFF,0xFFFF,0xFFFF,0xFFFF,0xFFFF,0xFFFF,0xFFFF,0xFFFF,0xFFFF,0xFFFF,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0xFFFF,0xFFFF};

// ========== air_premia (20x20) ==========
static const uint16_t PROGMEM logo_airpremia[] = {0xEF5D,0xEF5D,0xEF5D,0xEF5D,0xEF5D,0xEF5D,0xEF5D,0xEF5D,0xEF5D,0xEF5D,0xEF5D,0xEF5D,0xEF5D,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0xEF5D,0xEF5D};

// ========== french_bee (20x18) ==========
static const uint16_t PROGMEM logo_frenchbee[] = {0xFFFF,0xFFFF,0xFFFF,0xFFFF,0xFFFF,0xFFFF,0xFFFF,0xFFFD,0x157C,0xFFFE,0xFFFF,0xFFFF,0xFFFF,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0xFFFF,0xFFFF};

// ========== air_china (20x20) ==========
static const uint16_t PROGMEM logo_airchina[] = {0xFFFF,0xFFFF,0xFFFF,0xFFFF,0xFFFF,0xFFFF,0xFFFF,0xFFFF,0xFFFF,0xFFFF,0xFFFF,0xFFFF,0xFFFF,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0xFFFF,0xFFFF};

// ========== china_eastern (20x20) ==========
static const uint16_t PROGMEM logo_chinaeast[] = {0xFFFF,0xFFFF,0xFFFF,0xFFFF,0xFFFF,0xFFFF,0xFFFF,0xFFFF,0xFFFF,0xFFFF,0xFFFF,0xFFFF,0xFFFF,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0xFFFF,0xFFFF};

// ========== china_southern (20x20) ==========
static const uint16_t PROGMEM logo_chinasouth[] = {0x0000,0x0000,0x0000,0x0000,0x0000,0x0000,0x0000,0x0000,0x0000,0x0000,0x0000,0x0000,0x0000,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0x0000,0x0000};

// ========== breeze (20x20) ==========
static const uint16_t PROGMEM logo_breeze[] = {0x08C6,0x08C6,0x08C6,0x08C6,0x08C6,0x08C6,0x08C6,0x08C6,0x08C6,0x08C6,0x08C6,0x08C6,0x08C6,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0x08C6,0x08C6};

// ========== sun_country (20x20) ==========
static const uint16_t PROGMEM logo_suncountry[] = {0xFFFF,0xFFFF,0xFFFF,0xFFFF,0xFFFF,0xFFFF,0xFFFF,0xFFFF,0xFFFF,0xF406,0xFFFF,0xFFFF,0xFFFF,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0xFFFF,0xFFFF}; 

// ========== westjet (20x20) ==========
static const uint16_t PROGMEM logo_westjet[] = {0xFFFF,0xFFFF,0xFFFF,0xFFFF,0xFFFF,0xFFFF,0xFFFF,0xFFFF,0xFFFF,0xFFFF,0xFFFF,0xFFFF,0xFFFF,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0xFFFF,0xFFFF};

// ========== porter (20x20) ==========
static const uint16_t PROGMEM logo_porter[] = {0x0948,0x0128,0x0148,0x0927,0x0128,0x0128,0x0128,0x0128,0x0128,0x0127,0x0128,0x0128,0x0128,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0x0128,0x0128};

// ========== finnar (20x20) ==========
static const uint16_t PROGMEM logo_finnair[] = {0xFFFF,0xFFFF,0xFFFF,0xFFFF,0xFFFF,0xFFFF,0xFFFF,0xFFFF,0xF79E,0x3333,0x3333,0xF79E,0xFFFF,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0xFFFF,0xFFFF};

// ========== GENERIC AIRPLANE FALLBACK (19x20, 1-bit monochrome) ==========
static const unsigned char PROGMEM logo_generic_plane[] = {
  0x00, 0x00, 0x60, 0x00, 0x00, 0xe0, 0x01, 0x01, 0xc0, 0x52, 0x63, 0x80,
  0xff, 0xff, 0x80, 0x0f, 0xff, 0x00, 0x03, 0xfe, 0x00, 0x00, 0xfe, 0x00,
  0x00, 0x7f, 0x80, 0x00, 0xff, 0x00, 0x01, 0xef, 0x00, 0x03, 0xc7, 0x40,
  0x03, 0x87, 0x80, 0xff, 0x03, 0x00, 0x7e, 0x03, 0x80, 0x0e, 0x01, 0x80,
  0x16, 0x01, 0x80, 0x06, 0x00, 0x80, 0x02, 0x00, 0x80, 0x02, 0x00, 0x00
};

// ========== AIRLINE LOOKUP TABLE ==========
struct Airline {
  const char* prefix;
  const uint16_t* logo;  // nullptr = use generic fallback
  uint8_t w;
  uint8_t h;
  uint8_t xOff;
  uint8_t yOff;
  bool isGeneric;  // true = 1-bit bitmap, false = RGB565
};

Airline* findAirlineLogo(const char* callsign);

Airline airlines[] = {
  // === EXISTING AIRLINES ===
  { "UAL", logo_united, 20, 20, 0, 1, false },
  { "UA", logo_united, 20, 20, 0, 1, false },
  { "DAL", logo_delta, 20, 16, 0, 1, false },
  { "DL", logo_delta, 20, 16, 0, 1, false },
  { "AAL", logo_american, 20, 20, 0, 1, false },
  { "AA", logo_american, 20, 20, 0, 1, false },
  { "SWA", logo_southwest, 19, 18, 1, 1, false },
  { "WN", logo_southwest, 19, 18, 1, 1, false },
  { "ASA", logo_alaska, 19, 18, 0, 1, false },
  { "AS", logo_alaska, 19, 18, 0, 1, false },
  { "DLH", logo_lufthansa, 20, 20, 0, 1, false },
  { "LH", logo_lufthansa, 20, 20, 0, 1, false },

  // === JETBLUE ===
  { "JBU", logo_jetblue, 20, 20, 0, 1, false },
  { "B6", logo_jetblue, 20, 20, 0, 1, false },

  // === AIR CANADA ===
  { "ACA", logo_aircanada, 19, 19, 0, 1, false },
  { "AC", logo_aircanada, 19, 19, 0, 1, false },

  // === SKYWEST (United's #1 regional at SFO) ===
  { "SKW", nullptr, 19, 20, 0, 1, true },
  { "OO", nullptr, 19, 20, 0, 1, true },

  // === SFO MAJOR AIRLINES ===
  { "VIR", logo_virgin, 20, 20, 0, 1, false },
  { "VX", logo_virgin, 20, 20, 0, 1, false },
  { "NKS", logo_spirit, 20, 20, 0, 1, false },
  { "NK", logo_spirit, 20, 20, 0, 1, false },
  { "AWE", logo_allegiant, 20, 10, 0, 1, false },
  { "AAY", logo_allegiant, 20, 10, 0, 1, false },
  { "HAL", logo_hawaiian, 20, 23, 0, 1, false },
  { "HA", logo_hawaiian, 20, 23, 0, 1, false },
  { "TSE", logo_tahiti, 20, 20, 0, 1, false },
  { "TN", logo_tahiti, 20, 20, 0, 1, false },

  // === NEW 2026 SFO ROUTES ===
  { "AVE", logo_avianca, 20, 20, 0, 1, true },  // Avianca (GUA)
  { "AV", logo_avianca, 20, 20, 0, 1, true },
  { "LOT", logo_lot, 19, 19, 0, 1, true },  // LOT Polish (WAW)
  { "LO", logo_lot, 19, 19, 0, 1, true },

  // === INTERNATIONAL SFO ROUTES ===
  { "ANA", logo_ana, 19, 14, 0, 1, false },
  { "NH", logo_ana, 19, 14, 0, 1, false },
  { "JAL", logo_jal, 20, 20, 0, 1, false },
  { "JL", logo_jal, 20, 20, 0, 1, false },
  { "CPA", logo_cathay, 20, 20, 0, 1, false },
  { "CX", logo_cathay, 20, 20, 0, 1, false },
  { "KLM", logo_klm, 20, 20, 0, 1, false },
  { "KL", logo_klm, 20, 20, 0, 1, false },
  { "AFR", logo_france, 20, 14, 0, 1, false },
  { "AF", logo_france, 20, 14, 0, 1, false },
  { "BAW", logo_british, 17, 5, 0, 1, false },
  { "BA", logo_british, 17, 5, 0, 1, false },
  { "UAE", logo_emirates, 16, 19, 0, 1, false },
  { "EK", logo_emirates, 16, 19, 0, 1, false },
  { "QTR", logo_qatar, 20, 20, 0, 1, false },
  { "QR", logo_qatar, 20, 20, 0, 1, false },
  { "SIA", logo_sg, 14, 19, 0, 1, false },
  { "SQ", logo_sg, 14, 19, 0, 1, false },
  { "KAL", logo_korean, 20, 20, 0, 1, false },
  { "KE", logo_korean, 20, 20, 0, 1, false },
  { "AAR", logo_asiana, 20, 20, 0, 1, false },
  { "OZ", logo_asiana, 20, 20, 0, 1, false },
// === QANTAS ===
  { "QFA", logo_qantas, 19, 19, 0, 1, false },  // Qantas (Sydney/Melbourne)
  { "QF", logo_qantas, 19, 19, 0, 1, false },

  // === TRANS-PACIFIC CARRIERS ===
  { "EVA", logo_eva, 20, 15, 0, 1, true },  // EVA Air (TPE)
  { "BR", logo_eva, 20, 15, 0, 1, true },
  { "CAL", logo_china, 20, 16, 0, 1, true },  // China Airlines (TPE)
  { "CI", logo_china, 20, 16, 0, 1, true },
  { "ANZ", logo_anz, 20, 20, 0, 1, true },  // Air New Zealand (AKL)

  // === STARLUX & ADDITIONAL TRANS-PACIFIC ===
  { "JX", logo_starlux, 20, 20, 0, 1, true },   // Starlux Airlines (TPE)
  { "ZG", logo_zipair, 20, 16, 0, 1, true },   // Zipair (NRT)

  // === LATAM & MEXICO ===
  { "AM", logo_mexico, 20, 18, 0, 1, true },   // Aeromexico (MEX)

  // === EUROPEAN CARRIERS ===
  { "DE", logo_condor, 20, 20, 0, 1, true },   // Condor (FRA)

  // === CARGO & OTHERS ===
  { "FDX", logo_fedex, 20, 21, 0, 1, false },
  { "FX", logo_fedex, 20, 21, 0, 1, false },
  { "UPS", logo_ups, 17, 20, 0, 1, false },
  { "5X", logo_ups, 17, 20, 0, 1, false },

  // === ADDITIONAL DOMESTIC ===
  { "FLG", logo_frontier, 20, 20, 0, 1, false },
  { "FFT", logo_frontier, 20, 20, 0, 1, false },
  { "VRD", logo_virgin, 20, 20, 0, 1, false },
  
  // === VIETNAM & SE ASIA ===
  { "HVN", logo_vietnam, 20, 20, 0, 1, false }, // Vietnam Airlines
  { "VN", logo_vietnam, 20, 20, 0, 1, false },
  { "PAL", logo_philippine, 20, 20, 0, 1, false }, // Philippine Airlines
  { "PR", logo_philippine, 20, 20, 0, 1, false },
  { "FJI", logo_fiji, 20, 20, 0, 1, false }, // Fiji Airways
  { "FJ", logo_fiji, 20, 20, 0, 1, false },

// === LATIN AMERICA ===
  { "CMP", logo_copa, 20, 20, 0, 1, false },  // Copa Airlines (Panama City)
  { "CM", logo_copa, 20, 20, 0, 1, false },

  // === INDIA & MIDDLE EAST ===
  { "AIC", logo_airindia, 19, 19, 0, 1, false }, // Air India
  { "AI", logo_airindia, 19, 19, 0, 1, false },
  { "THY", logo_turkish, 20, 20, 0, 1, false }, // Turkish Airlines
  { "TK", logo_turkish, 20, 20, 0, 1, false },

  // === EUROPEAN FLAG CARRIERS ===
  { "SWR", logo_swiss, 20, 20, 0, 1, false }, // Swiss
  { "LX", logo_swiss, 20, 20, 0, 1, false },
  { "SAS", logo_sas, 20, 20, 0, 1, false }, // Scandinavian (SAS)
  { "SK", logo_sas, 20, 20, 0, 1, false },
  { "TAP", logo_tap, 20, 20, 0, 1, false }, // TAP Air Portugal
  { "TP", logo_tap, 20, 20, 0, 1, false },
  { "ITY", logo_ita, 20, 20, 0, 1, false }, // ITA Airways
  { "AZ", logo_ita, 20, 20, 0, 1, false },
  { "FIN", logo_finnair, 20, 20, 0, 1, false }, // Finnair
  { "AY", logo_finnair, 20, 20, 0, 1, false },
  { "EIN", logo_aerlingus, 20, 20, 0, 1, false }, // Aer Lingus
  { "EI", logo_aerlingus, 20, 20, 0, 1, false },

  // === MAINLAND CHINA & KOREA ===
  { "CCA", logo_airchina, 20, 20, 0, 1, false }, 
  { "CA", logo_airchina, 20, 20, 0, 1, false },
  { "CES", logo_chinaeast, 20, 20, 0, 1, false },
  { "MU", logo_chinaeast, 20, 20, 0, 1, false },
  { "CSN", logo_chinasouth, 20, 20, 0, 1, false },
  { "CZ", logo_chinasouth, 20, 20, 0, 1, false },
  { "APZ", logo_airpremia, 20, 20, 0, 1, false }, // Air Premia
  { "YP", logo_airpremia, 20, 20, 0, 1, false },

  // === LCC & REGIONAL ===
  { "FBU", logo_frenchbee, 20, 18, 0, 1, false }, // French bee
  { "BF", logo_frenchbee, 20, 18, 0, 1, false },
  { "MXY", logo_breeze, 20, 20, 0, 1, false }, // Breeze Airways
  { "MX", logo_breeze, 20, 20, 0, 1, false },
  { "SCX", logo_suncountry, 20, 20, 0, 1, false }, // Sun Country
  { "SY", logo_suncountry, 20, 20, 0, 1, false },
  { "WJA", logo_westjet, 20, 20, 0, 1, false }, // WestJet
  { "WS", logo_westjet, 20, 20, 0, 1, false },
  
  { "POE", logo_porter, 20, 20, 0, 1, false }, // Porter Airlines (Toronto/Ottawa)
  { "PD", logo_porter, 20, 20, 0, 1, false },
};

const int NUM_AIRLINES = sizeof(airlines) / sizeof(airlines[0]);

Airline* findAirlineLogo(const char* callsign) {
  for (int i = 0; i < NUM_AIRLINES; i++) {
    int len = strlen(airlines[i].prefix);
    if (strncmp(callsign, airlines[i].prefix, len) == 0 && isdigit((unsigned char)callsign[len])) {
      return &airlines[i];
    }
  }
  return nullptr;
}



// ========== FLIGHT DATA ==========
struct Flight {
  char callsign[16];
  char aircraftType[16];
  char origin[5];
  char destination[5];
  int altitude;
  int speed;
  int heading;
  int verticalRate;
  float distance;
  bool isInternational;
};

Flight currentFlights[10];
int totalFlights = 0;
int currentDisplayFlight = 0;

struct RouteCache {
  char callsign[16];
  char origin[5];
  char destination[5];
  unsigned long timestamp;
  bool valid;
  bool isInternational;
};

#define MAX_CACHE 50
RouteCache routeCache[MAX_CACHE];
int cacheIndex = 0;

// ========== CENTERED TEXT ==========
void printCentered(const char* text, int y, uint16_t color) {
  dma_display->setFont(&Org_01);
  dma_display->setTextWrap(false);
  int16_t x1, y1;
  uint16_t w, h;
  dma_display->getTextBounds(text, 0, 0, &x1, &y1, &w, &h);
  int x = (PANEL_RES_X - (int)w) / 2;
  if (x < 0) x = 0;
  dma_display->setTextColor(color);
  dma_display->setCursor(x, y);
  dma_display->print(text);
}

// ========== SEARCHING ANIMATION ==========
void drawSearching() {
  static unsigned long lastDotTime = 0;
  static int dotCount = 0;
  static bool forceDraw = true;

  if (forceDraw || millis() - lastDotTime > 500) {
    forceDraw = false;
    dotCount = (dotCount + 1) % 4;
    lastDotTime = millis();

    dma_display->fillScreen(COL_BLACK);
    printCentered("Searching", 14, COL_WHITE);

    char dots[5] = "";
    for (int i = 0; i < dotCount; i++) strcat(dots, ".");
    if (dotCount > 0) printCentered(dots, 24, COL_ORANGE);
  }
}

void drawBootStatus(const char* line1, const char* line2) {
  if (!dma_display) return;
  dma_display->fillScreen(COL_BLACK);
  printCentered(line1, line2 ? 12 : 16, COL_ORANGE);
  if (line2) printCentered(line2, 22, COL_WHITE);
}

// ========== HELPERS ==========
float calculateDistance(float lat1, float lon1, float lat2, float lon2) {
  float R = 3959.0;
  float dLat = (lat2 - lat1) * PI / 180.0;
  float dLon = (lon2 - lon1) * PI / 180.0;
  float a = sin(dLat / 2) * sin(dLat / 2) + cos(lat1 * PI / 180.0) * cos(lat2 * PI / 180.0) * sin(dLon / 2) * sin(dLon / 2);
  return R * 2 * atan2(sqrt(a), sqrt(1 - a));
}

const char* getCardinalDirection(int heading) {
  if (heading >= 337 || heading < 23) return "N";
  if (heading >= 23 && heading < 68) return "NE";
  if (heading >= 68 && heading < 113) return "E";
  if (heading >= 113 && heading < 158) return "SE";
  if (heading >= 158 && heading < 203) return "S";
  if (heading >= 203 && heading < 248) return "SW";
  if (heading >= 248 && heading < 293) return "W";
  if (heading >= 293 && heading < 337) return "NW";
  return "N";
}

// ========== HEADING ARROW ==========
void drawHeadingArrow(int cx, int cy, int heading, uint16_t color) {
  if (cx < 3) cx = 3;
  if (cx > PANEL_RES_X - 4) cx = PANEL_RES_X - 4;
  if (cy < 3) cy = 3;
  if (cy > PANEL_RES_Y - 4) cy = PANEL_RES_Y - 4;

  int dir = ((heading + 22) / 45) % 8;

  const int8_t shafts[8][4] = {
    { 0, 2, 0, -2 },
    { -2, 2, 2, -2 },
    { -2, 0, 2, 0 },
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    { 2, 2, -2, -2 },
  };
  const int8_t wings[8][4] = {
    { -1, 1, 1, 1 },
    { 0, 2, -2, 0 },
    { -1, -1, -1, 1 },
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    { 2, 0, 0, 2 },
  };

  int bx = cx + shafts[dir][0], by = cy + shafts[dir][1];
  int tx = cx + shafts[dir][2], ty = cy + shafts[dir][3];

  dma_display->drawLine(bx, by, tx, ty, color);
  dma_display->drawPixel(tx + wings[dir][0], ty + wings[dir][1], color);
  dma_display->drawPixel(tx + wings[dir][2], ty + wings[dir][3], color);
}

// ========== HTTP HELPERS ==========
// TLS needs ~40KB stack + contiguous heap. HUB75 DMA drops free heap hard, so:
//  1) a permanent HTTPS worker with a STATIC 48KB stack (never fails to spawn)
//  2) first flight fetch runs BEFORE the panel starts
static const char* HTTP_UA =
    "Mozilla/5.0 (ESP32; FlightTracker) AppleWebKit/537.36 "
    "(KHTML, like Gecko) Chrome/120.0.0.0 Safari/537.36";

static JsonDocument gAdsbDoc;
static char gFetchUrl[288];
static String* gFetchPayload = nullptr;
static volatile int gFetchResult = 0;   // 0=pending, 1=ok, -1=fail
static volatile int gFetchHttpCode = 0;
enum FetchMode : uint8_t { FETCH_JSON = 0, FETCH_STRING = 1 };
static FetchMode gFetchMode = FETCH_JSON;

static constexpr uint32_t HTTPS_STACK_WORDS = 12288;  // 48KB
static StackType_t gHttpsStack[HTTPS_STACK_WORDS];
static StaticTask_t gHttpsTaskMem;
static TaskHandle_t gHttpsTask = nullptr;
static SemaphoreHandle_t gHttpsGo = nullptr;
static SemaphoreHandle_t gHttpsDone = nullptr;

static void applyPublicDns() {
  WiFi.config(INADDR_NONE, INADDR_NONE, INADDR_NONE,
              IPAddress(8, 8, 8, 8), IPAddress(1, 1, 1, 1));
}

bool ensureWifi() {
  if (WiFi.status() == WL_CONNECTED) return true;
  Serial.println("WiFi lost — reconnecting...");
  WiFi.disconnect(false, false);
  delay(200);
  applyPublicDns();
  WiFi.begin(ssid, password);
  for (int i = 0; i < 30; i++) {
    if (WiFi.status() == WL_CONNECTED) {
      Serial.printf("WiFi reconnected, IP=%s DNS=%s heap=%u\n",
                    WiFi.localIP().toString().c_str(),
                    WiFi.dnsIP().toString().c_str(),
                    ESP.getFreeHeap());
      return true;
    }
    delay(500);
  }
  Serial.println("WiFi reconnect failed");
  return false;
}

static void logNetDiag(const char* host) {
  Serial.printf("Net: IP=%s GW=%s DNS=%s RSSI=%d heap=%u maxAlloc=%u\n",
                WiFi.localIP().toString().c_str(),
                WiFi.gatewayIP().toString().c_str(),
                WiFi.dnsIP().toString().c_str(),
                WiFi.RSSI(),
                ESP.getFreeHeap(),
                ESP.getMaxAllocHeap());
  if (!host || !host[0]) return;
  IPAddress ip;
  if (WiFi.hostByName(host, ip)) {
    Serial.printf("DNS %s -> %s\n", host, ip.toString().c_str());
    WiFiClient plain;
    Serial.printf("Plain TCP :443 ... ");
    if (plain.connect(ip, 443, 8000)) {
      Serial.println("OK");
      plain.stop();
    } else {
      Serial.println("FAIL — campus network may be blocking outbound HTTPS");
    }
  } else {
    Serial.printf("DNS FAILED for %s\n", host);
  }
}

static const char* hostFromUrl(const char* url, char* buf, size_t buflen) {
  buf[0] = '\0';
  const char* p = strstr(url, "://");
  if (!p) return buf;
  p += 3;
  const char* slash = strchr(p, '/');
  size_t n = slash ? (size_t)(slash - p) : strlen(p);
  if (n >= buflen) n = buflen - 1;
  memcpy(buf, p, n);
  buf[n] = '\0';
  char* colon = strchr(buf, ':');
  if (colon) *colon = '\0';
  return buf;
}

static bool httpsWorkOnThisTask() {
  mqttPauseForFetch();

  WiFiClientSecure client;
  client.setInsecure();
  client.setTimeout(20000);

  HTTPClient http;
  http.setConnectTimeout(20000);
  http.setTimeout(30000);
  http.setReuse(false);
  http.setFollowRedirects(HTTPC_STRICT_FOLLOW_REDIRECTS);
  http.setUserAgent(HTTP_UA);
  http.useHTTP10(true);

  bool ok = false;
  do {
    if (!http.begin(client, gFetchUrl)) {
      Serial.println("HTTP begin failed");
      break;
    }
    http.addHeader("Accept", "application/json");
    http.addHeader("Accept-Encoding", "identity");
    http.addHeader("Connection", "close");

    int code = http.GET();
    gFetchHttpCode = code;
    if (code != 200) {
      Serial.printf("HTTP %d (%s)\n", code, HTTPClient::errorToString(code).c_str());
      char host[64];
      logNetDiag(hostFromUrl(gFetchUrl, host, sizeof(host)));
      http.end();
      break;
    }

    String body = http.getString();
    http.end();
    client.stop();
    Serial.printf("HTTP body %u bytes, heap=%u\n", body.length(), ESP.getFreeHeap());
    if (body.length() < 2) {
      Serial.println("Empty HTTP body");
      break;
    }

    if (gFetchMode == FETCH_STRING) {
      if (!gFetchPayload) break;
      *gFetchPayload = body;
      ok = true;
      break;
    }

    gAdsbDoc.clear();
    DeserializationError err = deserializeJson(gAdsbDoc, body);
    body = String();
    if (err) {
      Serial.printf("JSON err: %s heap=%u\n", err.c_str(), ESP.getFreeHeap());
      break;
    }

    size_t nAc = 0;
    if (gAdsbDoc["ac"].is<JsonArray>()) nAc = gAdsbDoc["ac"].as<JsonArray>().size();
    else if (gAdsbDoc["aircraft"].is<JsonArray>()) nAc = gAdsbDoc["aircraft"].as<JsonArray>().size();
    else if (gAdsbDoc["states"].is<JsonArray>()) nAc = gAdsbDoc["states"].as<JsonArray>().size();
    Serial.printf("Parse ok — %u aircraft/states, heap=%u\n", (unsigned)nAc, ESP.getFreeHeap());
    ok = true;
  } while (false);

  mqttResumeAfterFetch();
  return ok;
}

static void httpsWorkerLoop(void*) {
  for (;;) {
    if (xSemaphoreTake(gHttpsGo, portMAX_DELAY) != pdTRUE) continue;
    bool ok = httpsWorkOnThisTask();
    gFetchResult = ok ? 1 : -1;
    xSemaphoreGive(gHttpsDone);
  }
}

void startHttpsWorker() {
  if (gHttpsTask) return;
  gHttpsGo = xSemaphoreCreateBinary();
  gHttpsDone = xSemaphoreCreateBinary();
  gHttpsTask = xTaskCreateStaticPinnedToCore(
      httpsWorkerLoop, "httpsW", HTTPS_STACK_WORDS, nullptr, 1,
      gHttpsStack, &gHttpsTaskMem, 0);
  Serial.printf("HTTPS worker started (static 48KB stack), heap=%u\n", ESP.getFreeHeap());
}

static bool runHttpsJob() {
  if (!gHttpsTask) {
    Serial.println("HTTPS worker missing");
    return false;
  }
  gFetchResult = 0;
  gFetchHttpCode = 0;
  xSemaphoreGive(gHttpsGo);
  if (xSemaphoreTake(gHttpsDone, pdMS_TO_TICKS(45000)) != pdTRUE) {
    Serial.println("https worker timed out");
    return false;
  }
  return gFetchResult == 1;
}

bool httpGet(const String& url, String& payload, int timeoutMs = 15000) {
  (void)timeoutMs;
  if (!ensureWifi()) return false;
  if (url.length() >= sizeof(gFetchUrl)) return false;
  strncpy(gFetchUrl, url.c_str(), sizeof(gFetchUrl) - 1);
  gFetchUrl[sizeof(gFetchUrl) - 1] = '\0';
  gFetchMode = FETCH_STRING;
  gFetchPayload = &payload;
  bool ok = runHttpsJob();
  gFetchPayload = nullptr;
  return ok;
}

bool fetchAdsbJson(const String& url) {
  if (!ensureWifi()) return false;
  if (url.length() >= sizeof(gFetchUrl)) return false;
  strncpy(gFetchUrl, url.c_str(), sizeof(gFetchUrl) - 1);
  gFetchUrl[sizeof(gFetchUrl) - 1] = '\0';
  gFetchMode = FETCH_JSON;
  Serial.printf("Fetch start heap=%u maxAlloc=%u\n", ESP.getFreeHeap(), ESP.getMaxAllocHeap());
  Serial.println(gFetchUrl);
  return runHttpsJob();
}

static int jsonAltitudeFt(JsonVariant ac) {
  if (ac["alt_baro"].is<const char*>()) {
    const char* s = ac["alt_baro"];
    if (!s || strcmp(s, "ground") == 0) return 0;
  } else if (!ac["alt_baro"].isNull()) {
    int a = ac["alt_baro"].as<int>();
    if (a != 0) return a;
  }
  if (!ac["alt_geom"].isNull() && !ac["alt_geom"].is<const char*>()) {
    return ac["alt_geom"].as<int>();
  }
  return 0;
}

// ========== ROUTE LOOKUP ==========
bool getRouteFromADSBDB(const char* callsign, int altitude,
                        char* origin, char* destination, bool* isIntl) {
  *isIntl = false;

  for (int i = 0; i < MAX_CACHE; i++) {
    if (routeCache[i].valid && strcmp(routeCache[i].callsign, callsign) == 0) {
      if (millis() - routeCache[i].timestamp < 3600000UL) {
        strcpy(origin, routeCache[i].origin);
        strcpy(destination, routeCache[i].destination);
        *isIntl = routeCache[i].isInternational;
        return true;
      }
    }
  }

  String payload;
  String url = "https://api.adsbdb.com/v0/callsign/" + String(callsign);
  if (!httpGet(url, payload, 8000)) {
    return false;
  }

  JsonDocument doc;
  if (!deserializeJson(doc, payload) && doc["response"].is<JsonObject>()) {
    JsonObject response = doc["response"];
    if (response.containsKey("flightroute")) {
      JsonObject flightroute = response["flightroute"];

      char tempOrigin[5] = "", tempDest[5] = "";
      bool hasOrigin = false, hasDest = false, isInternational = false;

      if (flightroute.containsKey("origin")) {
        JsonObject o = flightroute["origin"];
        if (o.containsKey("iata_code")) {
          const char* orig = o["iata_code"];
          if (orig && strlen(orig) >= 3) {
            strncpy(tempOrigin, orig, 3);
            tempOrigin[3] = '\0';
            hasOrigin = true;
          }
        }
        if (o.containsKey("country_iso_name")) {
          const char* c = o["country_iso_name"];
          if (c && strcmp(c, "US") != 0) isInternational = true;
        }
      }

      if (flightroute.containsKey("destination")) {
        JsonObject d = flightroute["destination"];
        if (d.containsKey("iata_code")) {
          const char* dest = d["iata_code"];
          if (dest && strlen(dest) >= 3) {
            strncpy(tempDest, dest, 3);
            tempDest[3] = '\0';
            hasDest = true;
          }
        }
        if (d.containsKey("country_iso_name")) {
          const char* c = d["country_iso_name"];
          if (c && strcmp(c, "US") != 0) isInternational = true;
        }
      }

      if (hasOrigin && hasDest) {
        strcpy(origin, tempOrigin);
        strcpy(destination, tempDest);
        *isIntl = isInternational;

        RouteCache* slot = &routeCache[cacheIndex];
        cacheIndex = (cacheIndex + 1) % MAX_CACHE;
        strncpy(slot->callsign, callsign, 15);
        slot->callsign[15] = '\0';
        strncpy(slot->origin, tempOrigin, 3);
        slot->origin[3] = '\0';
        strncpy(slot->destination, tempDest, 3);
        slot->destination[3] = '\0';
        slot->isInternational = isInternational;
        slot->timestamp = millis();
        slot->valid = true;
        return true;
      }
    }
  }

  return false;
}

// ========== FLIGHT FETCH ==========
void getFlights() {
  int apiRadius = SEARCH_RADIUS;
  if (apiRadius > ADSB_API_RADIUS_CAP) apiRadius = ADSB_API_RADIUS_CAP;
  if (apiRadius < 5) apiRadius = 5;

  String lat = String(MY_LAT, 6);
  String lon = String(MY_LON, 6);
  String dist = String(apiRadius);

  String urlLol = "https://api.adsb.lol/v2/lat/" + lat + "/lon/" + lon + "/dist/" + dist;
  String urlFi  = "https://opendata.adsb.fi/api/v2/lat/" + lat + "/lon/" + lon + "/dist/" + dist;

  JsonDocument& doc = gAdsbDoc;

  // adsb.fi first — more reliable from ESP; lol as fallback; OpenSky last.
  bool ok = fetchAdsbJson(urlFi);
  if (!ok) {
    Serial.println("adsb.fi failed — trying adsb.lol...");
    ok = fetchAdsbJson(urlLol);
  }
  if (!ok) {
    Serial.println("adsb.lol failed — trying OpenSky...");
    float dLat = apiRadius / 60.0f;
    float cosLat = cosf(MY_LAT * 0.0174532925f);
    if (cosLat < 0.2f) cosLat = 0.2f;
    float dLon = apiRadius / (60.0f * cosLat);
    String urlOs = "https://opensky-network.org/api/states/all"
                   "?lamin=" + String(MY_LAT - dLat, 4) +
                   "&lomin=" + String(MY_LON - dLon, 4) +
                   "&lamax=" + String(MY_LAT + dLat, 4) +
                   "&lomax=" + String(MY_LON + dLon, 4);
    ok = fetchAdsbJson(urlOs);
    if (!ok) {
      Serial.println("ADSB failed on all providers");
      return;
    }
  }

  // --- Step 2: Parse into lightweight raw structs, then free the doc ---
  struct RawFlight {
    char  callsign[16];
    char  aircraftType[16];
    float lat, lon;
    int   altitude, speed, heading, vertRate;
  };
  RawFlight raw[10];
  int rawCount = 0;

  {
    JsonArray aircraft;
    if (doc["ac"].is<JsonArray>()) {
      aircraft = doc["ac"].as<JsonArray>();
    } else if (doc["aircraft"].is<JsonArray>()) {
      aircraft = doc["aircraft"].as<JsonArray>();
    }

    if (!aircraft.isNull() && aircraft.size() > 0) {
      Serial.printf("Local ADS-B: %u aircraft\n", aircraft.size());
      for (JsonVariant ac : aircraft) {
        if (rawCount >= 10) break;

        String callsign = ac["flight"].as<String>();
        callsign.trim();
        callsign.toUpperCase();
        if (callsign.length() == 0) continue;

        if (!isCommercialCallsign(callsign.c_str())) {
          continue;
        }

        float flat = ac["lat"].as<float>();
        float flon = ac["lon"].as<float>();
        if (flat == 0 && flon == 0) continue;

        int altitude = jsonAltitudeFt(ac);
        if (altitude < MIN_ALTITUDE) continue;

        String aircraftType = ac["t"].as<String>();
        aircraftType.trim();
        aircraftType.toUpperCase();
        if (aircraftType.length() == 0) continue;

        if (isBlockedType(aircraftType.c_str())) continue;

        int speed    = ac["gs"].as<int>();
        int heading  = ac["track"].as<int>();
        int vertRate = ac["baro_rate"].as<int>();
        if (speed <= 0) continue;

        strncpy(raw[rawCount].callsign,     callsign.c_str(),     15); raw[rawCount].callsign[15]     = '\0';
        strncpy(raw[rawCount].aircraftType, aircraftType.c_str(), 15); raw[rawCount].aircraftType[15] = '\0';
        raw[rawCount].lat      = flat;
        raw[rawCount].lon      = flon;
        raw[rawCount].altitude = altitude;
        raw[rawCount].speed    = speed;
        raw[rawCount].heading  = heading;
        raw[rawCount].vertRate = vertRate;
        rawCount++;
      }
    } else if (doc["states"].is<JsonArray>()) {
      // OpenSky: [icao24, callsign, country, time_pos, last, lon, lat, baro_alt_m,
      //           on_ground, velocity_mps, true_track, vert_rate_mps, ...]
      JsonArray states = doc["states"].as<JsonArray>();
      Serial.printf("OpenSky: %u states\n", states.size());
      for (JsonVariant st : states) {
        if (rawCount >= 10) break;
        if (!st.is<JsonArray>()) continue;
        JsonArray row = st.as<JsonArray>();
        if (row.size() < 11) continue;
        if (row[8].as<bool>()) continue;  // on_ground

        String callsign = row[1].as<String>();
        callsign.trim();
        callsign.toUpperCase();
        if (callsign.length() == 0) continue;
        if (!isCommercialCallsign(callsign.c_str())) continue;

        float flon = row[5].as<float>();
        float flat = row[6].as<float>();
        if (flat == 0 && flon == 0) continue;

        float altM = row[7].isNull() ? 0 : row[7].as<float>();
        int altitude = (int)(altM * 3.28084f);
        if (altitude < MIN_ALTITUDE) continue;

        float vel = row[9].isNull() ? 0 : row[9].as<float>();
        int speed = (int)(vel * 1.94384f);  // m/s -> knots
        if (speed <= 0) continue;

        int heading = row[10].isNull() ? 0 : (int)row[10].as<float>();
        float vr = row[11].isNull() ? 0 : row[11].as<float>();
        int vertRate = (int)(vr * 196.85f);  // m/s -> ft/min approx

        strncpy(raw[rawCount].callsign, callsign.c_str(), 15);
        raw[rawCount].callsign[15] = '\0';
        // OpenSky has no type code — use placeholder so display still works
        strncpy(raw[rawCount].aircraftType, "JET", 15);
        raw[rawCount].aircraftType[15] = '\0';
        raw[rawCount].lat      = flat;
        raw[rawCount].lon      = flon;
        raw[rawCount].altitude = altitude;
        raw[rawCount].speed    = speed;
        raw[rawCount].heading  = heading;
        raw[rawCount].vertRate = vertRate;
        rawCount++;
      }
    } else {
      Serial.println("No aircraft in response");
      return;
    }
  }
  doc.clear();
  doc.shrinkToFit();

  Serial.printf("Raw candidates: %d\n", rawCount);
  if (rawCount == 0) {
    Serial.println("No commercial flights found, keeping previous list");
    return;
  }

  // --- Step 3: Route lookups — heap is free of the big JSON doc ---
  Flight tempFlights[10];
  int tempTotal = 0;

  for (int i = 0; i < rawCount; i++) {
    char origin[5] = "", destination[5] = "";
    bool isIntl = false;
    if (ESP.getFreeHeap() > 90000) {
      getRouteFromADSBDB(raw[i].callsign, raw[i].altitude, origin, destination, &isIntl);
    }

    strncpy(tempFlights[tempTotal].callsign,     raw[i].callsign,     15); tempFlights[tempTotal].callsign[15]     = '\0';
    strncpy(tempFlights[tempTotal].aircraftType, raw[i].aircraftType, 15); tempFlights[tempTotal].aircraftType[15] = '\0';
    strncpy(tempFlights[tempTotal].origin,       origin,               4); tempFlights[tempTotal].origin[4]        = '\0';
    strncpy(tempFlights[tempTotal].destination,  destination,          4); tempFlights[tempTotal].destination[4]   = '\0';
    tempFlights[tempTotal].altitude        = raw[i].altitude;
    tempFlights[tempTotal].speed           = raw[i].speed;
    tempFlights[tempTotal].heading         = raw[i].heading;
    tempFlights[tempTotal].verticalRate    = raw[i].vertRate;
    tempFlights[tempTotal].distance        = calculateDistance(MY_LAT, MY_LON, raw[i].lat, raw[i].lon);
    tempFlights[tempTotal].isInternational = isIntl;

    Serial.printf("✈ %s | %s | %dft | %dkt | %d° %s | intl:%d\n",
                  tempFlights[tempTotal].callsign,
                  tempFlights[tempTotal].aircraftType,
                  tempFlights[tempTotal].altitude,
                  tempFlights[tempTotal].speed,
                  tempFlights[tempTotal].heading,
                  getCardinalDirection(tempFlights[tempTotal].heading),
                  tempFlights[tempTotal].isInternational);
    tempTotal++;
    delay(300);
  }

  // --- Step 4: Commit results atomically ---
  if (tempTotal > 0) {
    memcpy(currentFlights, tempFlights, sizeof(Flight) * tempTotal);
    totalFlights = tempTotal;
    if (currentDisplayFlight >= totalFlights) currentDisplayFlight = 0;
    Serial.printf("✅ %d commercial flights ready\n", totalFlights);
  } else {
    Serial.println("⚠️  No commercial flights found, keeping previous list");
  }
}

// ========== DISPLAY ==========
void drawStaticContent(int index) {
  Flight* f = &currentFlights[index];

  if (strlen(f->aircraftType) == 0) {
    drawSearching();
    return;
  }

  dma_display->fillScreen(COL_BLACK);
  dma_display->setTextWrap(false);
  dma_display->setFont(&Org_01);
  dma_display->setTextColor(COL_WHITE);
  dma_display->setCursor(22, 5);
  dma_display->print(f->callsign);
  dma_display->setTextColor(COL_YELLOW);
  dma_display->setCursor(22, 13);
  dma_display->print(f->aircraftType);
  dma_display->setTextColor(COL_ORANGE);
  dma_display->setCursor(22, 21);

bool hasRoute = (strlen(f->origin) > 0 && strlen(f->destination) > 0);
bool hasSFO   = (strcmp(f->origin, "SFO") == 0 || strcmp(f->destination, "SFO") == 0);

if (hasRoute && (f->isInternational || hasSFO)) {
    char routeText[12];
    snprintf(routeText, sizeof(routeText), "%s-%s", f->origin, f->destination);
    dma_display->print(routeText);
} else {
    dma_display->print("Domestic");
}



// --- Logo / Fallback rendering ---
  Airline* airline = findAirlineLogo(f->callsign);
  if (airline && airline->logo != nullptr) {
    // Known airline: RGB565 bitmap
    dma_display->drawRGBBitmap(airline->xOff, airline->yOff,
                               airline->logo, airline->w, airline->h);
  } else {
    // Unknown airline or null logo: generic 1-bit airplane silhouette (19x20, white)
    dma_display->drawBitmap(0, 1,
                            logo_generic_plane,
                            19, 20,
                            COL_WHITE);
  }
}

void drawColoredMetric(const char* label, const char* value, const char* unit) {
  dma_display->fillRect(0, 23, PANEL_RES_X, 9, COL_BLACK);
  dma_display->setFont(&Org_01);
  dma_display->setTextWrap(false);

  int16_t x1, y1;
  uint16_t w, h;

  // Label anchored at x=0
  dma_display->setTextColor(COL_ORANGE);
  dma_display->setCursor(0, 29);
  dma_display->print(label);

  // Value fixed at x=22
  int cursorX = 22;
  dma_display->setTextColor(COL_WHITE);
  dma_display->setCursor(cursorX, 29);
  dma_display->print(value);
  dma_display->getTextBounds(value, 0, 0, &x1, &y1, &w, &h);
  cursorX += (int)w + 3;

  // Unit 3px after value
  dma_display->setTextColor(COL_YELLOW);
  dma_display->setCursor(cursorX, 29);
  dma_display->print(unit);
}

void drawHeadingMetric(int heading) {
  dma_display->fillRect(0, 23, PANEL_RES_X, 9, COL_BLACK);
  dma_display->setFont(&Org_01);
  dma_display->setTextWrap(false);

  char valueStr[8];
  snprintf(valueStr, sizeof(valueStr), "%d", heading);
  const char* cardinal = getCardinalDirection(heading);

  int16_t x1, y1;
  uint16_t w, h;

  // Label anchored at x=0
  dma_display->setTextColor(COL_ORANGE);
  dma_display->setCursor(0, 29);
  dma_display->print("HDG:");

  // Value fixed at x=22
  int cursorX = 22;
  dma_display->setTextColor(COL_WHITE);
  dma_display->setCursor(cursorX, 29);
  dma_display->print(valueStr);
  dma_display->getTextBounds(valueStr, 0, 0, &x1, &y1, &w, &h);
  cursorX += (int)w + 3;

  // Cardinal 3px after value
  dma_display->setTextColor(COL_YELLOW);
  dma_display->setCursor(cursorX, 29);
  dma_display->print(cardinal);
  dma_display->getTextBounds(cardinal, 0, 0, &x1, &y1, &w, &h);
  cursorX += (int)w + 5;

  // Arrow 3px after cardinal
  int arrowX = cursorX;
  if (arrowX > PANEL_RES_X - 7) arrowX = PANEL_RES_X - 7;
  drawHeadingArrow(arrowX, 27, heading, COL_ORANGE);
}




void showMetric(int flightIndex, int metricIndex) {
  Flight* f = &currentFlights[flightIndex];
  char valueBuf[16];

  switch (metricIndex) {
    case 0:
      snprintf(valueBuf, sizeof(valueBuf), "%d", f->altitude);
      drawColoredMetric("ALT:", valueBuf, "ft");
      break;
    case 1:
      snprintf(valueBuf, sizeof(valueBuf), "%d", f->speed);
      drawColoredMetric("SPD:", valueBuf, "kt");
      break;
    case 2:
      drawHeadingMetric(f->heading);
      break;
  }
}

// ========== WIFI ==========
const char* wifiStatusText(wl_status_t status) {
  switch (status) {
    case WL_IDLE_STATUS:     return "IDLE";
    case WL_NO_SSID_AVAIL:   return "NO_SSID (network not found)";
    case WL_SCAN_COMPLETED:  return "SCAN_COMPLETED";
    case WL_CONNECTED:       return "CONNECTED";
    case WL_CONNECT_FAILED:  return "CONNECT_FAILED (bad password/MAC?)";
    case WL_CONNECTION_LOST: return "CONNECTION_LOST";
    case WL_DISCONNECTED:    return "DISCONNECTED";
    default:                 return "UNKNOWN";
  }
}

bool connectWifi() {
  // IMPORTANT: call this BEFORE dma_display->begin().
  // HUB75 I2S DMA started first often makes WiFi scan return 0 networks.
  WiFi.persistent(false);
  WiFi.mode(WIFI_STA);
  WiFi.setSleep(false);
  WiFi.disconnect(true, true);
  delay(500);

  Serial.printf("ESP32 MAC (wifi-keys): %s\n", WiFi.macAddress().c_str());
  Serial.printf("Target SSID: \"%s\"\n", ssid);
  Serial.println("Scanning 2.4GHz networks...");

  // ESP32 classic is 2.4GHz only. iPhone hotspot needs "Maximize Compatibility".
  int n = WiFi.scanNetworks(/*async=*/false, /*hidden=*/true);
  Serial.printf("Scan found %d network(s):\n", n);
  bool found = false;
  for (int i = 0; i < n; i++) {
    String name = WiFi.SSID(i);
    Serial.printf("  [%d] \"%s\"  RSSI=%d  ch=%d\n",
                  i, name.c_str(), WiFi.RSSI(i), WiFi.channel(i));
    if (name == ssid) found = true;
  }
  WiFi.scanDelete();

  if (n <= 0) {
    Serial.println("Radio saw zero APs. Check antenna / board power / Maximize Compatibility on iPhone.");
    return false;
  }
  if (!found) {
    Serial.printf("Target \"%s\" not in list — update ssid/password in sketch to match hotspot or Berkeley-IoT.\n", ssid);
    return false;
  }

  Serial.printf("Connecting to \"%s\"...\n", ssid);
  applyPublicDns();
  WiFi.begin(ssid, password);

  const int maxAttempts = 60;  // ~30s
  for (int attempts = 0; attempts < maxAttempts; attempts++) {
    wl_status_t st = WiFi.status();
    if (st == WL_CONNECTED) {
      Serial.printf("\nWiFi OK  IP=%s  DNS=%s  RSSI=%d\n",
                    WiFi.localIP().toString().c_str(),
                    WiFi.dnsIP().toString().c_str(),
                    WiFi.RSSI());
      return true;
    }
    if (st == WL_CONNECT_FAILED) {
      Serial.printf("\nAuth failed: %s (wrong password?)\n", wifiStatusText(st));
      WiFi.disconnect(true, true);
      delay(500);
      applyPublicDns();
      WiFi.begin(ssid, password);
    }
    Serial.print(".");
    delay(500);
  }

  Serial.printf("\nWiFi FAILED: %s\n", wifiStatusText(WiFi.status()));
  return false;
}

// ========== SETUP ==========
void setup() {
  Serial.begin(115200);
  Serial.setTimeout(50);
  delay(500);

  for (int i = 0; i < MAX_CACHE; i++) routeCache[i].valid = false;

  // WiFi before HUB75 so scans work; panel comes up right after for boot UI.
  bool wifiOk = connectWifi();

  HUB75_I2S_CFG::i2s_pins _pins = {
    R1_PIN, G1_PIN, B1_PIN, R2_PIN, G2_PIN, B2_PIN,
    A_PIN, B_PIN, C_PIN, D_PIN, E_PIN,
    LAT_PIN, OE_PIN, CLK_PIN
  };

  HUB75_I2S_CFG mxconfig(PANEL_RES_X, PANEL_RES_Y, PANEL_CHAIN, _pins);
  dma_display = new MatrixPanel_I2S_DMA(mxconfig);
  dma_display->begin();
  dma_display->setBrightness8(255);
  dma_display->clearScreen();

  COL_ORANGE = dma_display->color565(255, 140, 0);
  COL_YELLOW = dma_display->color565(255, 220, 0);

  if (!wifiOk) {
    drawBootStatus("WiFi Failed", "See Serial");
    for (;;)
      ;
  }

  setupCloudControl();
  drawBootStatus("Connected!", nullptr);
  delay(900);

  startHttpsWorker();
  drawBootStatus("Loading", "flights");
  Serial.println("\n=== First fetch ===");
  getFlights();
  gAdsbDoc.clear();
  gAdsbDoc.shrinkToFit();
  Serial.printf("After first fetch heap=%u flights=%d\n", ESP.getFreeHeap(), totalFlights);
  applyPanelOutput();

  if (totalFlights == 0 && panelShouldShow()) {
    drawBootStatus("Searching", "...");
  }
}

// ========== LOOP ==========
void loop() {
  mqttLoop();

  if (Serial.available()) {
    String cmd = Serial.readStringUntil('\n');
    cmd.trim();
    if (!handleSerialPanelCommand(cmd)) {
      // ignore unknown
    }
  }

  static unsigned long lastFetch = millis();
  static unsigned long metricShownAt = 0;
  static int currentMetric = 0;
  static int lastFlight = -1;

  if (millis() - lastFetch > 10000) {
    Serial.println("\n📡 Fetching...");
    if (totalFlights == 0 && panelShouldShow()) drawBootStatus("Loading", "flights");
    getFlights();
    lastFetch = millis();
    applyPanelOutput();
  }

  // Scheduled / manual off — keep MQTT alive, blank the matrix
  if (!panelShouldShow()) {
    delay(50);
    return;
  }

  if (totalFlights == 0) {
    drawSearching();
    delay(50);
    return;
  }

  if (currentDisplayFlight != lastFlight) {
    currentMetric = 0;
    drawStaticContent(currentDisplayFlight);
    showMetric(currentDisplayFlight, currentMetric);
    metricShownAt = millis();
    lastFlight = currentDisplayFlight;
  }

  if (millis() - metricShownAt >= METRIC_HOLD_MS) {
    currentMetric++;

    if (currentMetric >= NUM_METRICS) {
      currentMetric = 0;
      currentDisplayFlight = (currentDisplayFlight + 1) % totalFlights;
    } else {
      showMetric(currentDisplayFlight, currentMetric);
    }

    metricShownAt = millis();
  }

  delay(50);
}



